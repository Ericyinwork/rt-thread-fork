## bsp/stm32/stm32f407-wtrs55dx/board/Kconfig
```kconfig
menu "Hardware Drivers Config"

config SOC_STM32F407VE
    bool
    select SOC_SERIES_STM32F4
    select RT_USING_COMPONENTS_INIT
    select RT_USING_USER_MAIN
    default y

menu "Onboard Peripheral Drivers"

	config BSP_USING_PRESSURE_SENSOR
		bool "Enable Pressure Sensor"
		select BSP_USING_SPI2
		default y

		if BSP_USING_PRESSURE_SENSOR
			choice
				prompt "pressure sensor"
				default BSP_USING_RSCDRRM020NDSE3
				help
					Select pressure sensor

				config BSP_USING_AD7730
					bool "AD7730"

				config BSP_USING_RSCDRRM020NDSE3
					bool "RSCDRRM020NDSE3"

			endchoice
		endif
		
endmenu

menu "On-chip Peripheral Drivers"

    config BSP_USING_GPIO
        bool "Enable GPIO"
        select RT_USING_PIN
        default y

    menuconfig BSP_USING_UART
        bool "Enable UART"
        default y
        select RT_USING_SERIAL
        if BSP_USING_UART
            config BSP_USING_UART1
                bool "Enable UART1"
                default y

            config BSP_UART1_RX_USING_DMA
                bool "Enable UART1 RX DMA"
                depends on BSP_USING_UART1 && RT_SERIAL_USING_DMA
                default n
				
			config BSP_UART1_TX_USING_DMA
                bool "Enable UART1 TX DMA"
                depends on BSP_USING_UART1 && RT_SERIAL_USING_DMA
                default n
        endif

menuconfig BSP_USING_I2C
        bool "Enable I2C BUS"
        default n
        select RT_USING_I2C
        select RT_USING_I2C_BITOPS
        select RT_USING_PIN
        if BSP_USING_I2C
            menuconfig BSP_USING_I2C1
                bool "Enable I2C1 BUS (software simulation)"
                default y
                if BSP_USING_I2C1
                    comment "Notice: PC0 --> 32; PC1 --> 33" 
                    config BSP_I2C1_SCL_PIN
                        int "i2c1 scl pin number"
                        range 1 176
                        default 32
                    config BSP_I2C1_SDA_PIN
                        int "I2C1 sda pin number"
                        range 1 176
                        default 33
                endif
 
            menuconfig BSP_USING_I2C2
                bool "Enable I2C2 BUS (AHT10)"
                default n
                if BSP_USING_I2C2
                    comment "Notice: PB10 --> 47; PB11 --> 48" 
                    config BSP_I2C2_SCL_PIN
                        int "i2c2 scl pin number"
                        range 1 176
                        default 47
                    config BSP_I2C2_SDA_PIN
                        int "I2C2 sda pin number"
                        range 1 176
                        default 48
                endif
        endif

    menuconfig BSP_USING_SPI
        bool "Enable SPI BUS"
        default n
        select RT_USING_SPI
        if BSP_USING_SPI
            config BSP_USING_SPI2
                bool "Enable SPI2 BUS"
                default n

            config BSP_SPI2_TX_USING_DMA
                bool "Enable SPI2 TX DMA"
                depends on BSP_USING_SPI2
                default n
                
            config BSP_SPI2_RX_USING_DMA
                bool "Enable SPI2 RX DMA"
                depends on BSP_USING_SPI2
                select BSP_SPI2_TX_USING_DMA
                default n
        endif
		
	config BSP_USING_USBD_FS
        bool "Enable OTGFS as USB device"
        select RT_USING_USB_DEVICE
        default n

	source "../libraries/HAL_Drivers/Kconfig"
endmenu

menu "Board extended module Drivers"

endmenu
 
endmenu
```
